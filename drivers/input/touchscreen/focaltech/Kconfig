## drivers/input/touchscreen/focaltech/Kconfig
```kconfig
#
# Focalteck FT6306 Touchscreen driver
#

config FT6306_TOUCHPANEL_DRIVER
	tristate "Focalteck FT6306 touchpanel driver"
	depends on TOUCHSCREEN_GT9XX
	depends on I2C
	help
	  This is the main file for touchpanel driver for Goodix GT9xx
	  touchscreens.

	  Say Y here if you have a Focalteck FT6306 touchscreen connected
	  to your system.

	  If unsure, say N.

	  To compile this driver as a module, choose M here: the
	  module will be called FT6306.
```
